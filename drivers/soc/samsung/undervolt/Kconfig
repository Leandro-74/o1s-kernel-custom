## drivers/soc/samsung/undervolt/Kconfig
```kconfig
# SPDX-License-Identifier: GPL-2.0
#
# Runtime undervolt interface for the Exynos 2100.
#

config SOC_EXYNOS2100_UV
	tristate "Runtime undervolt interface for Exynos 2100"
	depends on SOC_EXYNOS2100
	depends on CAL_IF
	help
	  Loadable module that exposes /sys/kernel/exynos_uv/ to apply a
	  percentage voltage margin to the Exynos 2100 CPU clusters and GPU.

	  The module only uses symbols exported by cmupmucal.ko; it does not
	  replace or modify the ROM module. The sysfs attributes take the
	  undervolt percentage as a positive number (0 to 100).

	  If unsure, say N.

config SOC_EXYNOS2100_UV_CL0
	int "Default undervolt for CPU cluster 0 (%)"
	depends on SOC_EXYNOS2100_UV
	range 0 100
	default 1
	help
	  Percentage of undervolt applied to CPU cluster 0 (little cores) when
	  the module is loaded. Zero disables the offset at load time.

config SOC_EXYNOS2100_UV_CL1
	int "Default undervolt for CPU cluster 1 (%)"
	depends on SOC_EXYNOS2100_UV
	range 0 100
	default 1
	help
	  Percentage of undervolt applied to CPU cluster 1 (big cores) when
	  the module is loaded. Zero disables the offset at load time.

config SOC_EXYNOS2100_UV_CL2
	int "Default undervolt for CPU cluster 2 (%)"
	depends on SOC_EXYNOS2100_UV
	range 0 100
	default 1
	help
	  Percentage of undervolt applied to CPU cluster 2 (prime core) when
	  the module is loaded. Zero disables the offset at load time.

config SOC_EXYNOS2100_UV_GPU
	int "Default undervolt for the GPU (%)"
	depends on SOC_EXYNOS2100_UV
	range 0 100
	default 1
	help
	  Percentage of undervolt applied to the GPU (G3D) when the module is
	  loaded. Zero disables the offset at load time.
```
